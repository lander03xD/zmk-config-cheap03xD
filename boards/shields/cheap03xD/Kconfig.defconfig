## boards/shields/cheap03xD/Kconfig.defconfig
```kconfig
if SHIELD_CHEAP03XD_LEFT

# Name must be less than 16 characters long!
config ZMK_KEYBOARD_NAME
    default "Cheap03xD"

#currently central is the left side
config ZMK_SPLIT_ROLE_CENTRAL
    default y

endif

if SHIELD_CHEAP03XD_LEFT || SHIELD_CHEAP03XD_RIGHT

config ZMK_SPLIT
    default y
    
#sleep settings
#Idle
config ZMK_IDLE_TIMEOUT
    default 20000

#Deep sleep
config ZMK_SLEEP
    default y

config ZMK_IDLE_SLEEP_TIMEOUT
    default 300000

#BLE settings
config ZMK_BLE_EXPERIMENTAL_CONN
    default y

#zephyr ble settings
config BT_PERIPHERAL_PREF_TIMEOUT
    default 800
    
config BT_PERIPHERAL_PREF_MIN_INT
    default 48
    
config BT_PERIPHERAL_PREF_MAX_INT
    default 80
    
config BT_PERIPHERAL_PREF_LATENCY
    default 5

endif
	
```

## boards/shields/comb03xD/Kconfig.defconfig
```kconfig
if SHIELD_COMB03XD_LEFT

# Name must be less than 16 characters long!
config ZMK_KEYBOARD_NAME
    default "Comb03xD"

#currently central is the left side
config ZMK_SPLIT_ROLE_CENTRAL
    default y

endif

if SHIELD_COMB03XD_LEFT || SHIELD_COMB03XD_RIGHT

config ZMK_SPLIT
    default y
    
#sleep settings
config ZMK_SLEEP
    default y

config ZMK_IDLE_SLEEP_TIMEOUT
    default 120000

#BLE settings
config ZMK_BLE_EXPERIMENTAL_CONN
    default y

    
#zephyr ble settings
config BT_PERIPHERAL_PREF_TIMEOUT
    default 600
    
config BT_PERIPHERAL_PREF_MIN_INT
    default 12
    
config BT_PERIPHERAL_PREF_MAX_INT
    default 24
    
config BT_PERIPHERAL_PREF_LATENCY
    default 30

endif
	
```

## boards/shields/comb03xD/Kconfig.shield
```kconfig
# No whitespace after the comma or in your part name!
config SHIELD_CHEAP03XD_LEFT
    def_bool $(shields_list_contains,cheap03xD_left)

# No whitespace after the comma or in your part name!
config SHIELD_CHEAP03XD_RIGHT
    def_bool $(shields_list_contains,cheap03xD_right)
```
